/*
 * Copyright (c) 2020 Pete Johanson
 *
 * SPDX-License-Identifier: MIT
 */

#include "samukun.dtsi"

// #include "samukun__tpoint0.dtsi"

// #include "samukun__gpio0.dtsi"

// #include "samukun__mlx90393.dtsi"

// #include "samukun__ads1220_load_cell.dtsi"
// #include "samukun__ads1220_tpoint_avdd.dtsi"
#include "samukun__ads1220_tpoint_idac.dtsi"

// fine tune for 6-wire trackpoint sensor board
&adc_ads1220_ch0 {
        zephyr,gain = "ADC_GAIN_32";
        zephyr,acquisition-time = <600>;
};
&adc_ads1220_ch1 {
        zephyr,gain = "ADC_GAIN_32";
        zephyr,acquisition-time = <600>;
};

// #include "samukun__maxtouch.dtsi"
