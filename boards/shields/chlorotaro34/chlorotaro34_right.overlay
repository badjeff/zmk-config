/*
 * Copyright (c) 2020 Pete Johanson
 *
 * SPDX-License-Identifier: MIT
 */

#include "chlorotaro34.dtsi"

&default_transform {
	col-offset = <5>;
};

&kscan0 {
	col-gpios
		= <&pro_micro 14 GPIO_ACTIVE_HIGH>
		, <&pro_micro 15 GPIO_ACTIVE_HIGH>
		, <&pro_micro 18 GPIO_ACTIVE_HIGH>
		, <&pro_micro 19 GPIO_ACTIVE_HIGH>
		, <&pro_micro 20 GPIO_ACTIVE_HIGH>
		;
};

// #include <input/processors/report_rate_limit.dtsi>
// #include <input/processors/xyz.dtsi>

// #include "chlorotaro34_trackball_pat9125.dtsi"
// &tball0 {
// 	// invert-x;
// 	// invert-y;
// };

// #include "chlorotaro34_zplit.dtsi"
// &tball0_split {
// 	device = <&tball0>;
// 	input-processors = <&zip_report_rate_limit 8>, <&zip_xyz>;
// };
