// Copyright (c) 2025, The ZMK Contributors
// SPDX-License-Identifier: MIT

#include <zephyr/dt-bindings/input/input-event-codes.h>

/ {
    /omit-if-no-ref/ zip_trixer: zip_trixer {
        compatible = "zmk,input-processor-trixer";
        #input-processor-cells = <1>;
        sync-report-ms = <1>;
        radius-um = <18500>;
        xy-sensitivity-num = <1>;
        xy-sensitivity-denom = <1>;
        z-sensitivity-num = <1>;
        z-sensitivity-denom = <15>;
        rotation-scale-num = <1>;
        rotation-scale-denom = <1>;
        yaw-scale-num = <1>;
        yaw-scale-denom = <1>;
        neutral-timeout-ms = <20>;
        smooth-len = <5>;
        rpt-dzn-x = <9>;
        rpt-dzn-y = <9>;
        rpt-dzn-z = <9>;
        rpt-dzn-rx = <9>;
        rpt-dzn-ry = <9>;
        rpt-dzn-rz = <9>;
    };
};
