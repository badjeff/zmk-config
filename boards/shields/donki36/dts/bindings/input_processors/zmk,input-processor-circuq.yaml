## boards/shields/donki36/dts/bindings/input_processors/zmk,input-processor-circuq.yaml
```yaml
# Copyright (c) 2025, The ZMK Contributors
# SPDX-License-Identifier: MIT

description: Input Processor for cirque pinnacle touch pad

compatible: "zmk,input-processor-cirque"

include: ip_zero_param.yaml

properties:

  edge-scroll-margin-h-pct:
    type: int
    default: 22

  edge-scroll-margin-v-pct:
    type: int
    default: 16

  edge-scroll-segment:
    type: int
    default: 48

  session-end-idle-ms:
    type: int
    default: 20

  sync-rel-xy-ms:
    type: int
    default: 1

  sync-rel-v-ms:
    type: int
    default: 15
```

## boards/shields/donki36/dts/bindings/input_processors/zmk,input-processor-cirque.yaml
```yaml
# Copyright (c) 2025, The ZMK Contributors
# SPDX-License-Identifier: MIT

description: Input Processor for cirque pinnacle touch pad

compatible: "zmk,input-processor-cirque"

include: ip_zero_param.yaml

properties:

  primary-tap-disable:
    type: boolean
    description: >-
      Primary tap detection is enabled by default.
      Set this property to disable the feature.

  secondary-tap-disable:
    type: boolean
    description: >-
      Secondary tap detection is enabled by default.
      Set this property to disable the feature.
      Tap on the edge-scroll ring as mouse right click.
      Depends on primary-tap.

  tap-max-ms:
    type: int
    default: 139
    description: >-
      Max gesture duration for tap detection, milliseconds.
      A gesture shorter than this can click instead of dragging or coasting.

  tap-max-drift:
    type: int
    default: 31
    description: >-
      Max gesture movement per axis for tap detection, counts.
      A gesture that drifted less than this per axis can click instead of
      dragging or coasting.

  edge-scroll-margin-h-pct:
    type: int
    default: 25
    description: >-
      Horizontal margin of the center (cursor) region, percent of the pad
      half-width. Touches inside the ellipse fall in the center (cursor)
      region; touches outside fall into the edge-scroll ring. Larger values
      shrink the cursor region.

  edge-scroll-margin-v-pct:
    type: int
    default: 19
    description: >-
      Vertical margin of the center (cursor) region, percent of the pad
      half-height. Similar to edge-scroll-margin-h-pct, but in vertical.

  edge-scroll-segment:
    type: int
    default: 48
    description: >-
      Number of angular segments the edge-scroll ring is split into. Crossing
      a segment boundary emits one wheel tick. Values < 2 fall back to a
      simple swipe up/down heuristic.

  edge-scroll-gesture-delay-ms:
    type: int
    default: 175
    description: >-
      Hold-on-edge delay before an edge touch qualifies as a scroll gesture,
      milliseconds. The rim touch must stay within
      edge-scroll-gesture-delay-drift for this long before wheel output
      starts and the haptic pulse fires. 0 = no hold, scroll starts
      immediately.

  edge-scroll-gesture-delay-drift:
    type: int
    default: 20
    description: >-
      Max movement per axis during the hold-on-edge window, counts.
      A touch that drifts beyond the threshold breaks the hold and stays
      silent until it comes to rest and holds again.

  session-end-idle-ms:
    type: int
    default: 20
    description: >-
      Idle time after the last touch frame before a gesture session is
      considered ended: runs tap detection and, for cursor sessions, starts
      the inertial glide.

  sync-rel-xy-ms:
    type: int
    default: 1
    description: >-
      Rate limit for emitting accumulated REL_X/REL_Y cursor deltas,
      milliseconds between reports.

  sync-rel-v-ms:
    type: int
    default: 15
    description: >-
      Rate limit for emitting accumulated REL_WHEEL scroll ticks,
      milliseconds between reports.

  inertial-disable:
    type: boolean
    description: >-
      Inertial cursor motion (flick then coast) is enabled by default.
      Set this property to disable the feature.

  inertial-decay-pct:
    type: int
    default: 90
    description: >-
      Glide velocity decay rate per tick, percent.
      Percentage of velocity to pass to next tick.

  inertial-start-velocity:
    type: int
    default: 500
    description: >-
      Minimum release velocity to start coasting, counts/s.
      0 = coast on every non-tap release.

  feedback-gpios:
    type: phandle-array
    description: |
      Haptic feedback GPIO pin.
      Pin is driven high while feedback is triggered.

  feedback-edge-scroll-start-ms:
    type: int
    default: 19
    description: >-
      Duration of haptic feedback on scroll gesture recognised.

  feedback-edge-scroll-trigger-ms:
    type: int
    default: 12
    description: >-
      Duration of haptic feedback on dragging across edge-scroll segments.
```
