## boards/arm/nologo_nano33_ble/Kconfig.defconfig
```kconfig
# Copyright (c) 2021 The ZMK Contributors
# SPDX-License-Identifier: MIT

if BOARD_NOLOGO_NANO33_BLE

config BOARD
    default "nologo_nana33_ble"

if USB_DEVICE_STACK

config USB_NRFX
    default y

endif # USB_DEVICE_STACK

config BT_CTLR
    default BT

endif # BOARD_NOLOGO_NANO33_BLE
```

## boards/shields/chlorotaro34/Kconfig.defconfig
```kconfig
if SHIELD_CHLOROTARO34_LEFT

config ZMK_KEYBOARD_NAME
    default "chlorotaro34"

config ZMK_SPLIT_ROLE_CENTRAL
    default y

endif

if SHIELD_CHLOROTARO34_LEFT || SHIELD_CHLOROTARO34_RIGHT

config ZMK_SPLIT
    default y

endif
```

## boards/shields/chlorotaro34/Kconfig.shield
```kconfig
# Copyright (c) 2020 Pete Johanson
# SPDX-License-Identifier: MIT

config SHIELD_CHLOROTARO34_LEFT
	def_bool $(shields_list_contains,chlorotaro34_left)

config SHIELD_CHLOROTARO34_RIGHT
	def_bool $(shields_list_contains,chlorotaro34_right)
```

## boards/shields/corne36/Kconfig.defconfig
```kconfig
if SHIELD_CORNE36_LEFT || SHIELD_CORNE36_DONGLE

config ZMK_KEYBOARD_NAME
    default "corne36"

config ZMK_SPLIT_ROLE_CENTRAL
    default y

endif

if SHIELD_CORNE36_LEFT || SHIELD_CORNE36_RIGHT || SHIELD_CORNE36_DONGLE || SHIELD_CORNE36_DONGLEFT

config ZMK_SPLIT
    default y

endif

if SHIELD_CORNE36_TBALL0 || SHIELD_CORNE36_TBALL1 || SHIELD_CORNE36_TBALL2 || SHIELD_CORNE36_TPOINT0 || SHIELD_CORNE36_TPAD0 || SHIELD_CORNE36_MOU0 || SHIELD_CORNE36_MOU1

config ZMK_SPLIT
    default y

endif
```

## boards/shields/corne36/Kconfig.shield
```kconfig
# Copyright (c) 2020 Pete Johanson
# SPDX-License-Identifier: MIT

config SHIELD_CORNE36_LEFT
	def_bool $(shields_list_contains,corne36_left)

config SHIELD_CORNE36_RIGHT
	def_bool $(shields_list_contains,corne36_right)

config SHIELD_CORNE36_TBALL0
	def_bool $(shields_list_contains,corne36_tball0)

config SHIELD_CORNE36_TBALL1
	def_bool $(shields_list_contains,corne36_tball1)

config SHIELD_CORNE36_TBALL2
	def_bool $(shields_list_contains,corne36_tball2)

config SHIELD_CORNE36_TPOINT0
	def_bool $(shields_list_contains,corne36_tpoint0)

config SHIELD_CORNE36_TPAD0
	def_bool $(shields_list_contains,corne36_tpad0)

config SHIELD_CORNE36_MOU0
	def_bool $(shields_list_contains,corne36_mou0)

config SHIELD_CORNE36_MOU1
	def_bool $(shields_list_contains,corne36_mou1)

config SHIELD_CORNE36_DONGLE
	def_bool $(shields_list_contains,corne36_dongle)

config SHIELD_CORNE36_DONGLEFT
	def_bool $(shields_list_contains,corne36_dongleft)
```

## boards/shields/donble36/Kconfig.defconfig
```kconfig
if SHIELD_DONBLE36_DONGLE || SHIELD_DONBLE36_DONGLX

config ZMK_KEYBOARD_NAME
    default "donble36"

config ZMK_SPLIT_ROLE_CENTRAL
    default y

endif

if SHIELD_DONBLE36_LEFT || SHIELD_DONBLE36_RIGHT || SHIELD_DONBLE36_DONGLE || SHIELD_DONBLE36_DONGLX

config ZMK_SPLIT
    default y

endif

if SHIELD_DONBLE36_TBALL0 || SHIELD_DONBLE36_TBALL1 || SHIELD_DONBLE36_TBALL2 || SHIELD_DONBLE36_TBALL3 || SHIELD_DONBLE36_TPOINT0 || SHIELD_DONBLE36_TPAD0 || SHIELD_DONBLE36_MOU0 || SHIELD_DONBLE36_MOU1 || SHIELD_DONBLE36_MOU2

config ZMK_SPLIT
    default y

endif
```

## boards/shields/donble36/Kconfig.shield
```kconfig
# Copyright (c) 2020 Pete Johanson
# SPDX-License-Identifier: MIT

config SHIELD_DONBLE36_DONGLE
	def_bool $(shields_list_contains,donble36_dongle)

config SHIELD_DONBLE36_DONGLX
	def_bool $(shields_list_contains,donble36_donglx)

config SHIELD_DONBLE36_LEFT
	def_bool $(shields_list_contains,donble36_left)

config SHIELD_DONBLE36_RIGHT
	def_bool $(shields_list_contains,donble36_right)

config SHIELD_DONBLE36_TBALL0
	def_bool $(shields_list_contains,donble36_tball0)

config SHIELD_DONBLE36_TBALL1
	def_bool $(shields_list_contains,donble36_tball1)

config SHIELD_DONBLE36_TBALL2
	def_bool $(shields_list_contains,donble36_tball2)

config SHIELD_DONBLE36_TBALL3
	def_bool $(shields_list_contains,donble36_tball3)

config SHIELD_DONBLE36_TPOINT0
	def_bool $(shields_list_contains,donble36_tpoint0)

config SHIELD_DONBLE36_TPAD0
	def_bool $(shields_list_contains,donble36_tpad0)

config SHIELD_DONBLE36_MOU0
	def_bool $(shields_list_contains,donble36_mou0)

config SHIELD_DONBLE36_MOU1
	def_bool $(shields_list_contains,donble36_mou1)

config SHIELD_DONBLE36_MOU2
	def_bool $(shields_list_contains,donble36_mou2)
```

## boards/shields/donble36/dts/bindings/input_processors/zmk,input-processor-mixer.yaml
```yaml
# Copyright (c) 2025, The ZMK Contributors
# SPDX-License-Identifier: MIT

description: Input Processor for mixing values after input events

compatible: "zmk,input-processor-mixer"

include: ip_one_param.yaml

properties:

  sync-report-ms:
    type: int
    required: true
    default: 1

  sync-report-yaw-ms:
    type: int
    required: true
    default: 30

  yaw-div:
    type: int
    required: true
    default: 1

  yaw-equator-threshold:
    type: int
    required: true
    default: 20

  yaw-min-per-tick:
    type: int
    required: true
    default: 40

  yaw-val-per-tick:
    type: int
    required: true
    default: 1
```

## boards/shields/nano18/Kconfig.shield
```kconfig
# Copyright (c) 2020 Pete Johanson
# SPDX-License-Identifier: MIT

config SHIELD_NANO18_LEFT
	def_bool $(shields_list_contains,nano18_left)

config SHIELD_NANO18_RIGHT
	def_bool $(shields_list_contains,nano18_right)
```

## boards/shields/puntero34/Kconfig.defconfig
```kconfig
if SHIELD_PUNTERO34_LEFT

config ZMK_KEYBOARD_NAME
    default "puntero34"

config ZMK_SPLIT_ROLE_CENTRAL
    default y

endif

if SHIELD_PUNTERO34_LEFT || SHIELD_PUNTERO34_RIGHT

config ZMK_SPLIT
    default y

endif
```

## boards/shields/puntero34/Kconfig.shield
```kconfig
# Copyright (c) 2020 Pete Johanson
# SPDX-License-Identifier: MIT

config SHIELD_PUNTERO34_LEFT
	def_bool $(shields_list_contains,puntero34_left)

config SHIELD_PUNTERO34_RIGHT
	def_bool $(shields_list_contains,puntero34_right)
```

## boards/shields/samukun/Kconfig.shield
```kconfig
# Copyright (c) 2020 Pete Johanson
# SPDX-License-Identifier: MIT

config SHIELD_SAMUKUN
	def_bool $(shields_list_contains,SAMUKUN)
```

## boards/shields/samukun/dts/bindings/input_processors/zmk,input-processor-ping.yaml
```yaml
# Copyright (c) 2025, The ZMK Contributors
# SPDX-License-Identifier: MIT

description: Input Processor for waking up analog-axis-hires

compatible: "zmk,input-processor-ping"

include: ip_one_param.yaml

properties:

  analog-axis-hires-dev:
    type: phandle
    required: true
```

## boards/shields/sparklite/Kconfig.defconfig
```kconfig
if SHIELD_SPARKLITE_LEFT

config ZMK_KEYBOARD_NAME
	default "Sparklite"

config ZMK_SPLIT_ROLE_CENTRAL
	default y

endif

if SHIELD_SPARKLITE_LEFT || SHIELD_SPARKLITE_RIGHT

config ZMK_SPLIT
	default y

endif
```

## boards/shields/sparklite/Kconfig.shield
```kconfig
# Copyright (c) 2020 Pete Johanson
# SPDX-License-Identifier: MIT

config SHIELD_SPARKLITE_LEFT
	def_bool $(shields_list_contains,sparklite_left)

config SHIELD_SPARKLITE_RIGHT
	def_bool $(shields_list_contains,sparklite_right)
```

## boards/shields/sparklite/dts/bindings/input_processors/zmk,input-processor-quadixer.yaml
```yaml
# Copyright (c) 2025, The ZMK Contributors
# SPDX-License-Identifier: MIT

description: 6-DOF Spacemouse input processor for 4 PAT9125 optical sensors on circular cylinder

compatible: "zmk,input-processor-quadixer"

include: ip_one_param.yaml

properties:

  sync-report-ms:
    type: int
    required: true
    default: 1

  sensor-radius-um:
    type: int
    required: false
    default: 8285
    description: Radius of sensor circle in micrometers (default 8.285mm)

  tracker-radius-um:
    type: int
    required: false
    default: 14000
    description: Radius of tracker circle in micrometers (default 14.0mm)

  xy-sensitivity-num:
    type: int
    required: false
    default: 1
    description: XY sensitivity numerator for scaling raw to mm

  xy-sensitivity-denom:
    type: int
    required: false
    default: 1
    description: XY sensitivity denominator for scaling raw to mm

  z-sensitivity-num:
    type: int
    required: false
    default: 1
    description: Z sensitivity numerator for scaling raw to mm

  z-sensitivity-denom:
    type: int
    required: false
    default: 1
    description: Z sensitivity denominator for scaling raw to mm

  pitch-scale-num:
    type: int
    required: false
    default: 1
    description: Pitch output scale numerator

  pitch-scale-denom:
    type: int
    required: false
    default: 1
    description: Pitch output scale denominator

  roll-scale-num:
    type: int
    required: false
    default: 1
    description: Roll output scale numerator

  roll-scale-denom:
    type: int
    required: false
    default: 1
    description: Roll output scale denominator

  yaw-scale-num:
    type: int
    required: false
    default: 1
    description: Yaw output scale numerator

  yaw-scale-denom:
    type: int
    required: false
    default: 1
    description: Yaw output scale denominator

  neutral-timeout-ms:
    type: int
    required: false
    default: 20
    description: Timeout in milliseconds before reporting neutral when all sensors are idle

  smooth-len:
    type: int
    default: 5
    description: Number of samples for smoothing

  rpt-dzn-x:
    type: int
    default: 0
    description: X-axis deadzone

  rpt-dzn-y:
    type: int
    default: 0
    description: Y-axis deadzone

  rpt-dzn-z:
    type: int
    default: 0
    description: Z-axis deadzone

  rpt-dzn-rx:
    type: int
    default: 0
    description: RX-axis deadzone

  rpt-dzn-ry:
    type: int
    default: 0
    description: RY-axis deadzone

  rpt-dzn-rz:
    type: int
    default: 0
    description: RZ-axis deadzone
```

## boards/shields/sparklite/dts/bindings/input_processors/zmk,input-processor-trixer.yaml
```yaml
# Copyright (c) 2025, The ZMK Contributors
# SPDX-License-Identifier: MIT

description: 6-DOF Spacemouse input processor for 3 magnetometers on circular PCB

compatible: "zmk,input-processor-trixer"

include: ip_one_param.yaml

properties:

  sync-report-ms:
    type: int
    required: true
    default: 1

  radius-um:
    type: int
    required: false
    default: 18500
    description: Radius of magnet circle in micrometers (default 18.5mm)

  xy-sensitivity-num:
    type: int
    required: false
    default: 1
    description: XY sensitivity numerator for scaling raw to mm

  xy-sensitivity-denom:
    type: int
    required: false
    default: 1
    description: XY sensitivity denominator for scaling raw to mm

  z-sensitivity-num:
    type: int
    required: false
    default: 1
    description: Z sensitivity numerator for scaling raw to mm

  z-sensitivity-denom:
    type: int
    required: false
    default: 1
    description: Z sensitivity denominator for scaling raw to mm

  rotation-scale-num:
    type: int
    required: false
    default: 1
    description: Rotation output scale numerator

  rotation-scale-denom:
    type: int
    required: false
    default: 1
    description: Rotation output scale denominator (pitch/roll)

  yaw-scale-num:
    type: int
    required: false
    default: 1
    description: Yaw output scale numerator

  yaw-scale-denom:
    type: int
    required: false
    default: 1
    description: Yaw output scale denominator

  neutral-timeout-ms:
    type: int
    required: false
    default: 50
    description: Timeout in milliseconds before reporting neutral when all sensors are idle
```

## boards/shields/tumka36/Kconfig.shield
```kconfig
# Copyright (c) 2020 Pete Johanson
# SPDX-License-Identifier: MIT

config SHIELD_TUMKA36
	def_bool $(shields_list_contains,TUMKA36)
```

## config/boards/arm/nologo_nano33_ble/Kconfig.board
```kconfig
# Copyright (c) 2021 The ZMK Contributors
# SPDX-License-Identifier: MIT

config BOARD_NOLOGO_NANO33_BLE
    bool "nologo_nana33_ble"
    depends on SOC_NRF52840_QIAA
```

## config/boards/arm/waveshare_rp2040_zero/Kconfig.board
```kconfig
# Copyright (c) 2021 Yonatan Schachter
# SPDX-License-Identifier: Apache-2.0

config BOARD_WAVESHARE_RP2040_ZERO
	bool "Waveshare RP2040 Zero Board"
	depends on SOC_RP2040
```

## config/boards/arm/waveshare_rp2040_zero/Kconfig.defconfig
```kconfig
# Copyright (c) 2021 Yonatan Schachter
# SPDX-License-Identifier: Apache-2.0

if BOARD_WAVESHARE_RP2040_ZERO

config BOARD
	default "waveshare_rp2040_zero"

config RP2_FLASH_W25Q080
	default y
	
endif # BOARD_WAVESHARE_RP2040_ZERO
```

## config/boards/shields/corne36/Kconfig.defconfig
```kconfig
if SHIELD_CORNE36_LEFT

config ZMK_KEYBOARD_NAME
    default "corne36"

config ZMK_SPLIT_ROLE_CENTRAL
    default y

endif

if SHIELD_CORNE36_LEFT || SHIELD_CORNE36_RIGHT

config ZMK_SPLIT
    default y

endif
```

## config/boards/shields/corne36/Kconfig.shield
```kconfig
# Copyright (c) 2020 Pete Johanson
# SPDX-License-Identifier: MIT

config SHIELD_CORNE36_LEFT
	def_bool $(shields_list_contains,corne36_left)

config SHIELD_CORNE36_RIGHT
	def_bool $(shields_list_contains,corne36_right)

config SHIELD_CORNE36_TBALL0
	def_bool $(shields_list_contains,corne36_tball0)

config SHIELD_CORNE36_TBALL1
	def_bool $(shields_list_contains,corne36_tball1)

config SHIELD_CORNE36_TPOINT0
	def_bool $(shields_list_contains,corne36_tpoint0)

config SHIELD_CORNE36_TPAD0
	def_bool $(shields_list_contains,corne36_tpad0)
```
