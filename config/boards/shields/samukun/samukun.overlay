/*
 * Copyright (c) 2020 Pete Johanson
 *
 * SPDX-License-Identifier: MIT
 */

#include "samukun.dtsi"

// #include "samukun__tpoint0.dtsi"

// #include "samukun__gpio0.dtsi"

// &pinctrl {
//     i2c0_default: i2c0_default {
//         group1 {
//             psels = <NRF_PSEL(TWIM_SDA, 0, 9)>,
//                     <NRF_PSEL(TWIM_SCL, 0, 10)>;
//         };
//     };

//     i2c0_sleep: i2c0_sleep {
//         group1 {
//             psels = <NRF_PSEL(TWIM_SDA, 0, 9)>,
//                     <NRF_PSEL(TWIM_SCL, 0, 10)>;
//             low-power-enable;
//         };
//     };
// };

// &i2c0 {
//     status = "okay";
//     compatible = "nordic,nrf-twim";
//     pinctrl-0 = <&i2c0_default>;
//     pinctrl-1 = <&i2c0_sleep>;
//     pinctrl-names = "default", "sleep";

//     // i2c_mlx90394: mlx90394@a0 {
//     //     compatible = "melexis,mlx90394";
//     //     status = "okay";
//     //     reg = <0xa0>;
//     // };
// };
