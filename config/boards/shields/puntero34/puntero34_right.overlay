/*
 * Copyright (c) 2020 Pete Johanson
 *
 * SPDX-License-Identifier: MIT
 */

#include "puntero34.dtsi"

&default_transform {
	col-offset = <5>;
};

#include <input/processors/report_rate_limit.dtsi>
#include <input/processors/xyz.dtsi>

#include "puntero34_trackball_pat9125.dtsi"
&tball0 {
	invert-x;
	invert-y;
};

#include "puntero34_zplit.dtsi"
&tball0_split {
	device = <&tball0>;
	input-processors = <&zip_report_rate_limit 6>, <&zip_xyz>;
};
