/*
 * Copyright (c) 2020 Pete Johanson
 *
 * SPDX-License-Identifier: MIT
 */

#include "sparklite.dtsi"

&kscan0 {
	col-gpios
		= <&gpio0 28 GPIO_ACTIVE_HIGH>
		, <&gpio0 29 GPIO_ACTIVE_HIGH>
		;
};

// #include "sparklite_trackball_adns9800.dtsi"
#include "sparklite_trackball_pmw3610.dtsi"
// #include "sparklite_trackball_paw3395.dtsi"

// / {
// 	erm0: output_generic_0 {
// 		compatible = "zmk,output-generic";
// 		#binding-cells = <0>;
// 		control-gpios = <&gpio0 4 GPIO_ACTIVE_HIGH>;
// 	};
// };
