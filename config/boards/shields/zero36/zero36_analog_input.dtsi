/*
 * Copyright (c) 2020 Pete Johanson
 *
 * SPDX-License-Identifier: MIT
 */

#include <zephyr/dt-bindings/input/input-event-codes.h>

&adc {
	status = "okay";
};

/ {
	anin0: analog_input_0 {
		compatible = "zmk,analog-input";
		
		sampling-hz = <100>;
		// sampling-hz = <50>;

		/* channels for thumbstick */
		// x-ch {
		// 	io-channels = <&adc 2>;
		// 	mv-mid = <1630>;
		// 	mv-min-max = <1600>;
		// 	mv-deadzone = <10>;
		// 	scale-multiplier = <1>;
		// 	scale-divisor = <70>;
		// 	invert;
		// 	evt-type = <INPUT_EV_REL>;
		// 	input-code = <INPUT_REL_X>;
		// };
		// y-ch {
		// 	io-channels = <&adc 3>;
		// 	mv-mid = <1630>;
		// 	mv-min-max = <1600>;
		// 	mv-deadzone = <10>;
		// 	scale-multiplier = <1>;
		// 	scale-divisor = <70>;
		// 	invert;
		// 	evt-type = <INPUT_EV_REL>;
		// 	input-code = <INPUT_REL_Y>;
		// };

		/* channels for ALPS RS60N11M9A0F motor fader / linear potentiometer */
		/* mV range: 50 ~ 19795 */
		y-ch {
			io-channels = <&adc 3>;

			/*** for mid-neutral knob ***/
			// mv-mid = <9898>;
			// mv-min-max = <9910>;
			// mv-deadzone = <75>;
			// scale-divisor = <77>;
			// scale-multiplier = <1>;
			// evt-type = <INPUT_EV_REL>;
			// input-code = <INPUT_REL_Y>;

			/*** for bottom-zero fader ***/
			mv-min-max = <19795>;  // raw max 19795
			mv-mid = <50>;         // raw min 50
			mv-deadzone = <8>;     // raw bouncing +/-5
			scale-divisor = <196>;
			scale-multiplier = <1>;
			evt-type = <INPUT_EV_ABS>;
			input-code = <INPUT_ABS_Y>;

			/* for joystick or knob, less packet ota */
			report-on-change-only;

		};

	};
};
