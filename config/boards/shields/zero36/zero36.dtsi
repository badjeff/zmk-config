/*
 * Copyright (c) 2020 Pete Johanson
 *
 * SPDX-License-Identifier: MIT
 */

#include <dt-bindings/zmk/matrix_transform.h>

/ {
	chosen {
		zmk,kscan = &kscan0;
		zmk,matrix-transform = &default_transform;
		// zephyr,display = &oled;
		// zephyr,console = &cdc_acm_uart;
	};

	default_transform: keymap_transform_0 {
		compatible = "zmk,matrix-transform";
		columns = <3>;
		rows = <1>;
		map = <
			RC(0,0) RC(0,1) RC(0,2)
		>;
	};

	kscan0: kscan {
		compatible = "zmk,kscan-gpio-matrix";
		label = "KSCAN";
		wakeup-source;
		diode-direction = "col2row";
		row-gpios
            = <&zero_header 14 (GPIO_ACTIVE_HIGH | GPIO_PULL_DOWN)>
            ;
		
		col-gpios
            = <&zero_header 13 GPIO_ACTIVE_HIGH>
						, <&zero_header 12 GPIO_ACTIVE_HIGH>
						, <&zero_header 11 GPIO_ACTIVE_HIGH>
						;
	};

};
