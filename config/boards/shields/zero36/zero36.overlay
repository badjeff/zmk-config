/*
 * Copyright (c) 2020 Pete Johanson
 *
 * SPDX-License-Identifier: MIT
 */

#include "zero36.dtsi"

// #include "zero36_trackball.dtsi"

#include "zero36_analog_input.dtsi"

// #include "zero36_led_strip.dtsi"

#include "zero36_drv883x.dtsi"

// #include "zero36_tb6612fng.dtsi"
