## config/boards/shields/donki36/Kconfig.defconfig
```kconfig
if SHIELD_DONKI36_DONGLE || SHIELD_DONKI36_DONGLX

config ZMK_KEYBOARD_NAME
    default "donki36"

config ZMK_SPLIT_ROLE_CENTRAL
    default y

endif

if SHIELD_DONKI36_LEFT || SHIELD_DONKI36_RIGHT || SHIELD_DONKI36_DONGLE || SHIELD_DONKI36_DONGLX

config ZMK_SPLIT
    default y

endif

if SHIELD_DONKI36_TBALL0 || SHIELD_DONKI36_TBALL1 || SHIELD_DONKI36_TBALL2 || SHIELD_DONKI36_TPOINT0 || SHIELD_DONKI36_TPAD0 || SHIELD_DONKI36_MOU0 || SHIELD_DONKI36_MOU1 || SHIELD_DONKI36_MOU2

config ZMK_SPLIT
    default y

endif
```

## config/boards/shields/donki36/Kconfig.shield
```kconfig
# Copyright (c) 2020 Pete Johanson
# SPDX-License-Identifier: MIT

config SHIELD_DONKI36_DONGLE
	def_bool $(shields_list_contains,donki36_dongle)

config SHIELD_DONKI36_DONGLX
	def_bool $(shields_list_contains,donki36_donglx)

config SHIELD_DONKI36_LEFT
	def_bool $(shields_list_contains,donki36_left)

config SHIELD_DONKI36_RIGHT
	def_bool $(shields_list_contains,donki36_right)

config SHIELD_DONKI36_TBALL0
	def_bool $(shields_list_contains,donki36_tball0)

config SHIELD_DONKI36_TBALL1
	def_bool $(shields_list_contains,donki36_tball1)

config SHIELD_DONKI36_TBALL2
	def_bool $(shields_list_contains,donki36_tball2)

config SHIELD_DONKI36_TPOINT0
	def_bool $(shields_list_contains,donki36_tpoint0)

config SHIELD_DONKI36_TPAD0
	def_bool $(shields_list_contains,donki36_tpad0)

config SHIELD_DONKI36_MOU0
	def_bool $(shields_list_contains,donki36_mou0)

config SHIELD_DONKI36_MOU1
	def_bool $(shields_list_contains,donki36_mou1)

config SHIELD_DONKI36_MOU2
	def_bool $(shields_list_contains,donki36_mou2)
```

## config/boards/shields/donki36/dts/bindings/zmk,behavior-battery-printer.yaml
```yaml
# SPDX-License-Identifier: MIT

description: "Behavior that types the battery percentage (digits only)."

compatible: "zmk,behavior-battery-printer"

include: zero_param.yaml
```

## config/boards/shields/nano18/Kconfig.defconfig
```kconfig
if SHIELD_NANO18_LEFT

config ZMK_KEYBOARD_NAME
    default "nano18"

config ZMK_SPLIT_ROLE_CENTRAL
    default y

endif

if SHIELD_NANO18_LEFT || SHIELD_NANO18_RIGHT

config ZMK_SPLIT
    default y

endif
```

## config/boards/shields/pmicro34/Kconfig.defconfig
```kconfig
if SHIELD_PMICRO34_LEFT

config ZMK_KEYBOARD_NAME
    default "pmicro34"

config ZMK_SPLIT_ROLE_CENTRAL
    default y

endif

if SHIELD_PMICRO34_LEFT || SHIELD_PMICRO34_RIGHT

config ZMK_SPLIT
    default y

endif
```

## config/boards/shields/pmicro34/Kconfig.shield
```kconfig
# Copyright (c) 2020 Pete Johanson
# SPDX-License-Identifier: MIT

config SHIELD_PMICRO34_LEFT
	def_bool $(shields_list_contains,pmicro34_left)

config SHIELD_PMICRO34_RIGHT
	def_bool $(shields_list_contains,pmicro34_right)
```

## config/boards/shields/samukun/dts/bindings/input/melexis,mlx90393-input-common.yaml
```yaml
# SPDX-License-Identifier: MIT

properties:
  irq-gpios:
    type: phandle-array
    description: Data ready gpio, INT pin on MLX90393

  no-x:
    type: boolean
    description: skip measure x axis on chip (default read xyz)
 
  no-y:
    type: boolean
    description: skip measure y axis on chip (default read xyz)

  no-z:
    type: boolean
    description: skip measure z axis on chip (default read xyz)

  calib-cycle:
    type: int
    default: 100
    description: count of auto calibration cycle

  woc-thd-trim-pctg:
    type: int
    default: 75
    description: |
      Percentage to trim calibration results before setup wake-on-change threshold.
      Adjust this to filter extreme cases on both ends of normal distributed readings.

  ex-woc-thd-xy:
    type: int
    default: 0
    description: extra delta for XY-axis wake-on-change threshold

  ex-woc-thd-z:
    type: int
    default: 0
    description: extra delta for Z-axis wake-on-change threshold

  downshift:
    type: int
    default: 75
    description: |
      Maximum in-deadzone-reading allow in burst mode interrupts before 
      downshift to wake-on change mode.
      Interrupt interval is hardcode to ~20ms, default 75 * ~20ms = 1500ms downshift

  rpt-dzn-x:
    type: int
    default: 150
    description: X-axis deadzone

  rpt-dzn-y:
    type: int
    default: 150
    description: Y-axis deadzone

  rpt-dzn-z:
    type: int
    default: 150
    description: Z-axis deadzone
```

## config/boards/shields/samukun/dts/bindings/input/melexis,mlx90393-input-i2c.yaml
```yaml
# SPDX-License-Identifier: MIT

description: |
  MLX90393 magnetic sensor input driver
  Reads magnetic field data from the MLX90393 via I2C 
  and reports X/Y/Z events.

compatible: "melexis,mlx90393-input"

include: [base.yaml, i2c-device.yaml, "melexis,mlx90393-input-common.yaml"]
```

## config/boards/shields/samukun/dts/bindings/input/melexis,mlx90393-input-spi.yaml
```yaml
# SPDX-License-Identifier: MIT

description: |
  MLX90393 magnetic sensor input driver
  Reads magnetic field data from the MLX90393 via SPI 
  and reports X/Y/Z events.

compatible: "melexis,mlx90393-input"

include: [base.yaml, spi-device.yaml, "melexis,mlx90393-input-common.yaml"]
```

## config/boards/shields/samukun/dts/bindings/input/melexis,mlx90393-input.yaml
```yaml
# SPDX-License-Identifier: MIT

description: |
  MLX90393 magnetic sensor input driver

  Reads magnetic field data from the MLX90393 via I2C and reports
  relative X/Y/Z events.

  Example usage:
    mlx90393_input: mlx90393-input@0c {
      compatible = "melexis,mlx90393-input";
      reg = <0x0C>;
      irq-gpios = <&gpio1 6 (GPIO_ACTIVE_HIGH | GPIO_PULL_DOWN)>;
    };

compatible: "melexis,mlx90393-input"

include: [base.yaml, i2c-device.yaml]

properties:
  irq-gpios:
    type: phandle-array
    description: Data ready gpio, INT pin on MLX90393

  calib-cycle:
    type: int
    default: 100
    description: count of auto calibration cycle

  woc-thd-xy-mul:
    type: int
    default: 30
    description: X-axis wake-on-change threshold multiplier

  woc-thd-z-mul:
    type: int
    default: 30
    description: X-axis wake-on-change threshold multiplier

  rpt-dzn-x:
    type: int
    default: 49
    description: X-axis deadzone

  rpt-dzn-y:
    type: int
    default: 49
    description: Y-axis deadzone

  rpt-dzn-z:
    type: int
    default: 49
    description: Z-axis deadzone
```

## config/west.yml
```yaml
manifest:
  remotes:
    # - name: zmkfirmware
    #   url-base: https://github.com/zmkfirmware
    # - name: nrfconnect
    #   url-base: https://github.com/nrfconnect
    # - name: petejohanson
    #   url-base: https://github.com/petejohanson
    - name: badjeff
      url-base: https://github.com/badjeff

  projects:

    # - name: zmk
    #   remote: zmkfirmware
    #   revision: main
    #   import: app/west.yml
    # - name: zmk
    #   remote: petejohanson
    #   revision: core/move-to-zephyr-4-1
    #   import: app/west.yml
    - name: zmk
      remote: badjeff
      revision: main
      import: app/west.yml

    # - name: sdk-nrf
    #   remote: badjeff
    #   revision: v3.1-branch+zmk-fixes
    #   path: nrf
    # - name: nrfxlib
    #   remote: nrfconnect
    #   revision: v3.1-branch
    #   repo-path: sdk-nrfxlib
    #   path: nrfxlib
    # - name: zmk-feature-split-esb
    #   remote: badjeff
    #   # revision: main
    #   revision: core/move-to-zephyr-4-1

    - name: zmk-adns9800-driver
      remote: badjeff
      revision: main

    - name: zmk-pmw3610-driver
      remote: badjeff
      revision: main
      # revision: zmk-0.4

    - name: zmk-paw3395-driver
      remote: badjeff
      revision: main

    - name: zmk-analog-input-driver
      remote: badjeff
      revision: main

    - name: zmk-behavior-battery-percentage-printer
      remote: badjeff
      revision: main

    - name: zmk-behavior-insomnia
      remote: badjeff
      revision: main

    - name: zmk-behavior-key-press-lip
      remote: badjeff
      revision: main

    - name: zmk-behavior-key-tempo
      remote: badjeff
      revision: main

    - name: zmk-behavior-mouse-key-toggle
      remote: badjeff
      revision: main

    # - name: zmk-input-behavior-listener
    #   remote: badjeff
    #   revision: main

    - name: zmk-output-behavior-listener
      remote: badjeff
      revision: main

    # - name: zmk-hid-io
    #   remote: badjeff
    #   revision: main

    # - name: zmk-split-peripheral-input-relay
    #   remote: badjeff
    #   revision: main

    # - name: zmk-split-peripheral-output-relay
    #   remote: badjeff
    #   revision: main

    - name: zmk-split-peripheral-bonding-tweak
      remote: badjeff
      revision: main

    - name: zmk-drv2605-driver
      remote: badjeff
      revision: main

    - name: zmk-drv883x-driver
      remote: badjeff
      revision: main

    - name: zmk-tb6612fng-driver
      remote: badjeff
      revision: main

    - name: zmk-mlx90393-driver
      remote: badjeff
      revision: main

    - name: zmk-kscan-blackout
      remote: badjeff
      revision: main

    # - name: zmk-input-processor-mixer
    #   remote: badjeff
    #   revision: main

    - name: zmk-input-processor-report-rate-limit
      remote: badjeff
      revision: main

    - name: zmk-input-processor-xyz
      remote: badjeff
      revision: main

    # - name: zmk-behavior-set-default-layer
    #   remote: badjeff
    #   revision: main

    - name: kb_zmk_ps2_mouse_trackpoint_driver
      remote: badjeff
      revision: main

    - name: cirque-input-module
      remote: badjeff
      revision: tweak

    - name: prospector-zmk-module
      remote: badjeff
      revision: 1-47-inch-panel

  self:
    path: config
```

## west.yml
```yaml
manifest:
  remotes:
    - name: badjeff
      url-base: https://github.com/badjeff
  projects:
    # Together with the above defined remote, this refers to a module located at
    # https://github.com/badjeff/zmk-config
    - name: zmk-config
      remote: badjeff
      # This points to a west manifest file in the remote module for further imports
      import: west.yml
```
